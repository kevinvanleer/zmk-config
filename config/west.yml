## config/west.yml
```yaml
manifest:
  remotes:
    - name: darknao
      url-base: https://github.com/darknao
  projects:
    - name: zmk
      remote: darknao
      revision: 22d6941d055bf05f006c9d4d7088e9564d31ba3a
      import: app/west.yml
  self:
    path: config
```
